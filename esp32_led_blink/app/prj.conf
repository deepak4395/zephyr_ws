## CMakeLists.txt
```
cmake_minimum_required(VERSION 3.20.0)
find_package(Zephyr REQUIRED HINTS $ENV{ZEPHYR_BASE})
project(esp32_led_blink)

target_sources(app PRIVATE src/main.c)
```

## prj.conf
```kconfig
CONFIG_MAIN_STACK_SIZE=2048

CONFIG_CONSOLE=y
CONFIG_SERIAL=y
CONFIG_UART_CONSOLE=y
CONFIG_UART_INTERRUPT_DRIVEN=y

CONFIG_GPIO=y
CONFIG_PRINTK=y
CONFIG_STDOUT_CONSOLE=y
```

## src/main.c
```c
#include <zephyr/kernel.h>
#include <zephyr/device.h>
#include <zephyr/drivers/gpio.h>
#include <zephyr/sys/printk.h>

/* LED GPIO configuration */
#define LED_GPIO_PORT		"GPIO_0"
#define LED_GPIO_PIN		13
#define LED_BLINK_INTERVAL	K_MSEC(1000)

int main(void)
{
	const struct device *led_dev;
	int ret;

	printk("ESP32 LED Blink starting...\n");

	/* Get GPIO device */
	led_dev = device_get_binding(LED_GPIO_PORT);
	if (led_dev == NULL) {
		printk("ERROR: GPIO device not found\n");
		return 1;
	}

	/* Configure LED pin as output */
	ret = gpio_pin_configure(led_dev, LED_GPIO_PIN, GPIO_OUTPUT_ACTIVE);
	if (ret != 0) {
		printk("ERROR: Failed to configure LED pin\n");
		return 1;
	}

	printk("LED configured on pin %d. Starting blink...\n", LED_GPIO_PIN);

	/* Blink loop */
	while (1) {
		/* LED on */
		gpio_pin_set(led_dev, LED_GPIO_PIN, 1);
		printk("LED ON\n");
		k_sleep(LED_BLINK_INTERVAL);

		/* LED off */
		gpio_pin_set(led_dev, LED_GPIO_PIN, 0);
		printk("LED OFF\n");
		k_sleep(LED_BLINK_INTERVAL);
	}

	return 0;
}
```
